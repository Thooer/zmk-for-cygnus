## config/west.yml
```yaml
manifest:
  remotes:
    - name: zmkfirmware
      url-base: https://github.com/zmkfirmware
    - name: kuolemax
      url-base: https://github.com/kuolemax
    - name: zephyrproject-rtos
      url-base: https://github.com/zephyrproject-rtos
  projects:
    - name: zmk
      remote: kuolemax
      revision: encoder-fix
      import: app/west.yml
    # - name: zmk
    #   remote: zmkfirmware
    #   revision: main
    #   import: app/west.yml

    - name: zephyr
      remote: zephyrproject-rtos
      revision: main
  self:
    path: config
```
